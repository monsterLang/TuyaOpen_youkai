## apps/tuya_cloud/01_i2c/Kconfig
```kconfig
menu "Application config"

    config EXAMPLE_I2C_SCL_PIN
        int "scl pin"
        default 6
        range 0 63

    config EXAMPLE_I2C_SDA_PIN
        int "sda pin"
        default 7
        range 0 63

endmenu
```

## boards/ESP32/ESP32-C3/Kconfig
```kconfig
config CHIP_CHOICE
    string
    default "esp32c3"

config BOARD_CHOICE
    string
    default "ESP32-C3"

config UART_NUM0_TX_PIN
    int "UART_NUM0_TX_PIN"
    range 0 21
    default 21
    ---help---
        esp32-c3 default 21

config UART_NUM0_RX_PIN
    int "UART_NUM0_RX_PIN"
    range 0 21
    default 20
    ---help---
        esp32-c3 default 20

choice ESP32C3_BOARD_EX_MODULE
    prompt "choose expansion module for esp32 c3"
    default ESP32C3_BOARD_EX_MODULE_LCD_ST7735

    config ESP32C3_BOARD_EX_MODULE_LCD_ST7735
        bool "1.8 inch 128x160 rgb565 LCD"
        select ENABLE_DISPLAY
        select ENABLE_TOUCH
endchoice
```

## boards/ESP32/ESP32-S3/Kconfig
```kconfig
config CHIP_CHOICE
    string
    default "esp32s3"

config BOARD_CHOICE
    string
    default "ESP32-S3"

config UART_NUM0_TX_PIN
    int "UART_NUM0_TX_PIN"
    range 0 44
    default 43
    ---help---
        esp32-s3 default 43

config UART_NUM0_RX_PIN
    int "UART_NUM0_RX_PIN"
    range 0 44
    default 44
    ---help---
        esp32-s3 default 44

choice ESP32S3_BOARD_EX_MODULE
    prompt "choose expansion module for esp32 s3"
    default ESP32S3_BOARD_EX_MODULE_LCD_ST7735

    config ESP32S3_BOARD_EX_MODULE_LCD_ST7735
        bool "1.8 inch 128x160 rgb565 LCD"
        select ENABLE_DISPLAY
        select ENABLE_TOUCH
endchoice
```
